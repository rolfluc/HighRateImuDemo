## CMakeLists.txt
```
# SPDX-License-Identifier: Apache-2.0

cmake_minimum_required(VERSION 3.20.0)

find_package(Zephyr REQUIRED HINTS $ENV{ZEPHYR_BASE})
project(ImuSample)

target_sources(app PRIVATE src/main.c)
target_sources(app PRIVATE "src/imu.c")

# BEGIN AUTO-ADDED BY MCUXPRESSO EXTENSION
target_sources(app PRIVATE "src/uart.c")
# END AUTO-ADDED BY MCUXPRESSO EXTENSION

# BEGIN AUTO-ADDED BY MCUXPRESSO EXTENSION
target_sources(app PRIVATE "src/spi.c")
# END AUTO-ADDED BY MCUXPRESSO EXTENSION

target_include_directories(app PRIVATE "inc/")
```

## prj.conf
```kconfig
CONFIG_SERIAL=y
CONFIG_UART_INTERRUPT_DRIVEN=y
CONFIG_SPI=y
CONFIG_GPIO=y
```

## app.overlay
```dts
/ {
    /* Using a standard compatible string gives Zephyr the parsing blueprint */
    my_gpio_pins {
        compatible = "gpio-leds";

        my_output_pin: gpio_pin_2_5 {
            gpios = <&gpio2 5 GPIO_ACTIVE_HIGH>;
            label = "USER_GPIO_P2_5";
        };
    };
};
```

## src/main.c
```c
/*
 * Copyright (c) 2022 Libre Solar Technologies GmbH
 *
 * SPDX-License-Identifier: Apache-2.0
 */

#include "uart.h"
#include "spi.h"
#include <zephyr/kernel.h>


int main(void)
{
	InitUart();
	// printk("%x",sys_clock_hw_cycles_per_sec());
	InitSpi();
	while(1) {

	}
	return 0;
}
```

## inc/imu.h
```c
#pragma once
#define LSM6_REG_CTRL1 0x10

#define LSM6_REG_PAGE_SEL 0x02
#define LSM6_REG_EMB_FUNC_EN_A 0x04
#define LSM6_REG_EMB_FUNC_EN_B 0x05
#define LSM6_REG_EMB_FUNC_EXEC_STATUS 0x07
#define LSM6_REG_PAGE_ADDRESS 0x08
#define LSM6_REG_PAGE_VALUE 0x09
#define LSM6_REG_EMB_FUNC_INT1 0x0A
#define LSM6_REG_FSM_INT1 0x0B
#define LSM6_REG_EMB_FUNC_INT2 0x0E
#define LSM6_REG_FSM_INT2 0x0F
#define LSM6_REG_EMB_FUNC_STATUS 0x12
#define LSM6_REG_FSM_STATUS 0x13
#define LSM6_REG_PAGE_RW 0x17
#define LSM6_REG_EMB_FUNC_FIFO_EN_A 0x44
#define LSM6_REG_FSM_ENABLE 0x46
#define LSM6_REG_FSM_LONG_COUNTER_L 0x48
#define LSM6_REG_FSM_LONG_COUNTER_H 0x49
#define LSM6_REG_INT_ACK_MASK 0x4B
#define LSM6_REG_FSM_OUTS1 0x4C
#define LSM6_REG_FSM_OUTS2 0x4D
#define LSM6_REG_FSM_OUTS3 0x4E
#define LSM6_REG_FSM_OUTS4 0x4F
#define LSM6_REG_FSM_OUTS5 0x50
#define LSM6_REG_FSM_OUTS6 0x51
#define LSM6_REG_FSM_OUTS7 0x52
#define LSM6_REG_FSM_OUTS8 0x53
#define LSM6_REG_SFLP_ODR 0x5E
#define LSM6_REG_FSM_ODR 0x5F
#define LSM6_REG_STEP_COUNTER_L 0x62
#define LSM6_REG_STEP_COUNTER_H 0x63
#define LSM6_REG_EMB_FUNC_SRC 0x64
#define LSM6_REG_EMB_FUNC_INIT_A 0x66
#define LSM6_REG_EMB_FUNC_INIT_B 0x67


#define LSM6_REG_SPI2_WHO_AM_I 0x0F
#define LSM6_REG_SPI2_STATUS_REG_OIS 0x1E
#define LSM6_REG_SPI2_OUT_TEMP_L 0x20
#define LSM6_REG_SPI2_OUT_TEMP_H 0x21
#define LSM6_REG_SPI2_OUTX_L_G_OIS 0x22
#define LSM6_REG_SPI2_OUTX_H_G_OIS 0x23
#define LSM6_REG_SPI2_OUTY_L_G_OIS 0x24
#define LSM6_REG_SPI2_OUTY_H_G_OIS 0x25
#define LSM6_REG_SPI2_OUTZ_L_G_OIS 0x26
#define LSM6_REG_SPI2_OUTZ_H_G_OIS 0x27
#define LSM6_REG_SPI2_OUTX_L_A_OIS 0x28
#define LSM6_REG_SPI2_OUTX_H_A_OIS 0x29
#define LSM6_REG_SPI2_OUTY_L_A_OIS 0x2A
#define LSM6_REG_SPI2_OUTY_H_A_OIS 0x2B
#define LSM6_REG_SPI2_OUTZ_L_A_OIS 0x2C
#define LSM6_REG_SPI2_OUTZ_H_A_OIS 0x2D
#define LSM6_REG_SPI2_HANDSHAKE_CTRL 0x6E
#define LSM6_REG_SPI2_INT_OIS 0x6F
#define LSM6_REG_SPI2_CTRL1_OIS 0x70
#define LSM6_REG_SPI2_CTRL2_OIS 0x71
#define LSM6_REG_SPI2_CTRL3_OIS 0x72

#define LSM6_READ 1 << 7
```

## inc/spi.h
```c
#pragma once

void InitSpi();
```

## inc/uart.h
```c
#pragma once
#include <stdint.h>

void InitUart();
void putChar(char c);
void putStrn(char* str, uint8_t len);
```

## src/spi.c
```c
#include "spi.h"
#include <zephyr/kernel.h>
#include <zephyr/device.h>
#include <zephyr/drivers/spi.h>
#include <zephyr/drivers/gpio.h>
#include "imu.h"
#include "uart.h"

#define SPI_RATE 1 * 1000 * 1000 // 8 Mhz
#define SPI_DEVICE_NODE DT_NODELABEL(lpspi1)
static const struct device *spi_dev;

#define TEST_GPIO
#ifdef TEST_GPIO

/* Define your pin index (P2_6) */
#define PIN_P2_6 6

/* 2. Configure the Software/GPIO Chip-Select Control Block */
static const struct spi_cs_control my_custom_cs = {
    .gpio = {
        .port = DEVICE_DT_GET(DT_NODELABEL(gpio2)),
        .pin = PIN_P2_6,
        .dt_flags = GPIO_ACTIVE_LOW, /* Keep it active low for standard SPI */
    },
    /* Option A: Using Nanoseconds explicitly */
    .setup_ns = 2000,  /* 2 us leading setup delay before the first clock edge */
    .hold_ns = 500,    /* 500 ns trailing hold delay after the last clock edge */
    
    /* Option B: Legacy microsecond approach (uncomment if your Zephyr target prefers it) */
    // .delay = 1,     /* Wait 1 us before starting transceive and 1 us before releasing */
};
#endif

static const struct spi_config spi_cfg = {
    .frequency = SPI_RATE, 
    .operation = SPI_WORD_SET(8) | SPI_TRANSFER_MSB, // mode 0 // 0x60
    // .operation = SPI_WORD_SET(8) | SPI_TRANSFER_MSB | SPI_MODE_CPHA, // mode 1 // 0x60
    // .operation = SPI_WORD_SET(8) | SPI_TRANSFER_MSB | SPI_MODE_CPOL, // mode 2 // 0x00
    //.operation = SPI_WORD_SET(8) | SPI_TRANSFER_MSB | SPI_MODE_CPOL | SPI_MODE_CPHA, // mode 3 // 0x60
    .slave = 1, // <-- Tells the driver to use PCS1 instead of PCS0
#ifdef TEST_GPIO
    .cs = my_custom_cs,
#else
    .cs = NULL,
#endif
    .word_delay = 0,
};

static const struct gpio_dt_spec custom_pin = GPIO_DT_SPEC_GET(DT_NODELABEL(my_output_pin), gpios);

void InitSpi() {
    spi_dev = DEVICE_DT_GET(SPI_DEVICE_NODE);

    k_msleep(50);
    if (!gpio_is_ready_dt(&custom_pin)) {
        printk("GPIO issue.\n");
        return;
    }
    int ret = gpio_pin_configure_dt(&custom_pin, GPIO_OUTPUT_INACTIVE);
    if (ret < 0) {
        printk("GPIO issue.\n");
        return;
    }
    // Reset the status of SDx/SDc.
    gpio_pin_set_dt(&custom_pin, 1);
    k_msleep(500);
    gpio_pin_set_dt(&custom_pin, 0);

    if (!device_is_ready(spi_dev)) {
        printk("SPI device not ready\n");
        return;
    }

    // Write bit is bit 0. Setting to 1 indicates read.
    uint8_t tx_whoami[2] = {0x8f, 0x00};
    uint8_t rx_whoami[2] = {0};
    struct spi_buf buf_tx_whoami = {.buf = tx_whoami, .len = sizeof(tx_whoami)};
    struct spi_buf buf_rx_whoami = {.buf = rx_whoami, .len = sizeof(rx_whoami)};
    struct spi_buf_set set_tx_whoami = {.buffers = &buf_tx_whoami, .count = 1};
    struct spi_buf_set set_rx_whoami = {.buffers = &buf_rx_whoami, .count = 1};
    ret = spi_transceive(spi_dev, &spi_cfg, &set_tx_whoami, &set_rx_whoami);

    if (ret != 0) {
        printk("SPI Failed WHOAMI\n");
    }
    if (rx_whoami[1] != 0x6b) {
        printk("SPI Failed WHOAMI - invalid data\n");
    }
    uint8_t tx_ctrl[2] = {0x10, 0xA0}; 
    struct spi_buf buf_tx_ctrl = {.buf = tx_ctrl, .len = sizeof(tx_ctrl)};
    struct spi_buf_set set_tx_ctrl = {.buffers = &buf_tx_ctrl, .count = 1};
    ret = spi_write(spi_dev, &spi_cfg, &set_tx_ctrl);
    if (ret != 0) {
        printk("SPI failed config\n");
    }

    // --- ADD THIS READ-BACK TEST HERE ---
    uint8_t tx_verify[2] = { 0x90, 0x00 }; // 0x90 (Read CTRL1)
    uint8_t rx_verify[2] = { 0 };
    struct spi_buf buf_verify_tx = {.buf = tx_verify, .len = 2};
    struct spi_buf buf_verify_rx = {.buf = rx_verify, .len = 2};
    struct spi_buf_set set_verify_tx = {.buffers = &buf_verify_tx, .count = 1};
    struct spi_buf_set set_verify_rx = {.buffers = &buf_verify_rx, .count = 1};

    spi_transceive(spi_dev, &spi_cfg, &set_verify_tx, &set_verify_rx);
    if (rx_verify[1] != 0x28) {
        printk("SPI Failed WHOAMI - invalid data\n");
    }

    uint8_t tx_data1[7] = {0xA8, 0x00, 0x00, 0x00, 0x00, 0x00, 0x00};
    uint8_t rx_data1[7] = {0};
    uint16_t accel_x,accel_y,accel_z = 0;
    struct spi_buf tx_buf1 = {.buf = tx_data1, .len = sizeof(tx_data1)};
    struct spi_buf rx_buf1 = {.buf = rx_data1, .len = sizeof(rx_data1)};
    struct spi_buf_set tx_set1 = {.buffers = &tx_buf1, .count = 1};
    struct spi_buf_set rx_set1 = {.buffers = &rx_buf1, .count = 1};

    char buffer[14];
    while(1) {
        // Now that we're ready, read it and report it out.
        ret = spi_transceive(spi_dev, &spi_cfg, &tx_set1, &rx_set1);
        accel_x = (uint16_t)((rx_data1[2] << 8) | rx_data1[1]);
        accel_y = (uint16_t)((rx_data1[4] << 8) | rx_data1[3]);
        accel_z = (uint16_t)((rx_data1[6] << 8) | rx_data1[5]);

        snprintf(buffer, sizeof(buffer), "%04X%04X%04X\n", accel_x, accel_y, accel_z);
        putStrn(buffer, sizeof(buffer));
        k_usleep(100);
    }
}
```

## src/uart.c
```c
#include "uart.h"
#include <zephyr/kernel.h>
#include <zephyr/device.h>
#include <zephyr/drivers/uart.h>

#include <string.h>

/* change this to any other UART peripheral if desired */
#define UART_DEVICE_NODE DT_CHOSEN(zephyr_shell_uart)

#define MSG_SIZE 32 // TODO
#define NUM_MSG 10
#define ALIGN 4

/* queue to store up to 10 messages (aligned to 4-byte boundary) */
K_MSGQ_DEFINE(uart_msgq, MSG_SIZE, NUM_MSG, ALIGN);

static const struct device *const uart_dev = DEVICE_DT_GET(UART_DEVICE_NODE);

/* receive buffer used in UART ISR callback */
static char rx_buf[MSG_SIZE];
static int rx_buf_pos;

/*
 * Read characters from UART until line end is detected. Afterwards push the
 * data to the message queue.
 */
void serial_cb(const struct device *dev, void *user_data)
{
	uint8_t c;

	if (!uart_irq_update(uart_dev)) {
		return;
	}

	if (!uart_irq_rx_ready(uart_dev)) {
		return;
	}

	/* read until FIFO empty */
	while (uart_fifo_read(uart_dev, &c, 1) == 1) {
        uart_poll_out(uart_dev, c);
	}
}

void InitUart() {
    if (!device_is_ready(uart_dev)) {
		printk("UART device not found!");
		return;
	}

    struct uart_config config;
    int ret = uart_config_get(uart_dev, &config);
    if (ret != 0) {
        // Handle error reading config
        return;
    }

    // 3. Update only the baudrate to your desired speed
    config.baudrate = 1228800; 

    // 4. Apply the new configuration
    ret = uart_configure(uart_dev, &config);
    if (ret != 0) {
        // Handle error applying config (e.g., hardware doesn't support that exact speed)
        return;
    }

	#if 0
	/* configure interrupt and callback to receive data */
	ret = uart_irq_callback_user_data_set(uart_dev, serial_cb, NULL);

	if (ret < 0) {
		if (ret == -ENOTSUP) {
			printk("Interrupt-driven UART API support not enabled\n");
		} else if (ret == -ENOSYS) {
			printk("UART device does not support interrupt-driven API\n");
		} else {
			printk("Error setting UART callback: %d\n", ret);
		}
		return;
	}
	uart_irq_rx_enable(uart_dev);
    // TODO migrate rx to TX for IRQ management. Won't need RX.
	#endif
}

void putChar(char c) {
    uart_poll_out(uart_dev, c);
}

void putStrn(char* str, uint8_t len) {
    for(uint8_t i = 0; i < len; i++) {
        uart_poll_out(uart_dev, str[i]);
    }
    // TODO move to IRQ based, for IMU integration.
    // TODO move to k_msgq_put(&uart_msgq, &rx_buf, K_NO_WAIT);
}
```
